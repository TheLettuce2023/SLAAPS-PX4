## Tools/research_sitl/bench_active/Kconfig
```kconfig
menuconfig EXAMPLES_BENCH_ACTIVE_TEST
	bool "Private capture-only bench integration fixture"
	default n
	depends on BOARD_PLATFORM = "posix"
```

## Tools/research_sitl/stabilized_observer/Kconfig
```kconfig
config EXAMPLES_STABILIZED_OBSERVER_TEST
	bool "stabilized_observer_test"
	default n
```

## Tools/research_sitl/stabilized_output/Kconfig
```kconfig
config EXAMPLES_STABILIZED_OUTPUT_TEST
	bool "stabilized_output_test"
	default n
```

## src/modules/research_bench_control/Kconfig
```kconfig
menuconfig MODULES_RESEARCH_BENCH_CONTROL
	bool "research_bench_control"
	default n
	help
		Explicitly started servo-only research bench owner. No automatic start,
		profile, output assignment or arming. Not qualified for physical use.
```

## src/modules/research_stabilized_manual/Kconfig
```kconfig
menuconfig MODULES_RESEARCH_STABILIZED_MANUAL
	bool "research_stabilized_manual"
	default n
	help
		Explicit-profile stabilized manual observer. Diagnostic output only;
		no actuator publication, automatic startup or enable. Requires a
		separate image from the research servo bench owner.

config RESEARCH_STABILIZED_OUTPUT_HOOK
	bool "Research MAIN PWM transaction hook (experimental)"
	default n
	depends on MODULES_RESEARCH_STABILIZED_MANUAL
	help
		Provide a permanently attached, serialized validation/completion guard
		around the MAIN PWM driver call. Does not install a guard, grant output
		authority, or enable stabilized control. Hardware acceptance is separate.
```

## src/modules/slaaps/Kconfig
```kconfig
menuconfig MODULES_SLAAPS
	bool "slaaps"
	default n
	depends on MODULES_COMMANDER
	help
		SLAAPS vehicle configuration and named-mode supervisor. Hardware output
		admission remains separate from mode registration and configuration.

config SLAAPS_ROUTING_TEST
	bool "SLAAPS synthetic routing and control native tests"
	default n
	depends on MODULES_SLAAPS && BOARD_NOLOCKSTEP && PLATFORM_POSIX
	help
		Publishes synthetic PWM-bank inventory and exposes the portable control
		test suite as a native PX4 command. Uses synthetic inputs and no outputs.
		Never enable this option in a vehicle firmware target.
```
